## sample.yaml
```
# This file is provided so that the application can be compiled using Twister,
# the Zephyr testing tool. In this file, multiple combinations can be specified,
# so that you can easily test all of them locally or in CI.
sample:
  description: Example application
  name: example-application
common:
  integration_platforms:
    - native_sim
tests:
  zephyr.test.app:
    timeout: 5
    harness: console
    harness_config:
      type: multi_line
      ordered: false
      regex:
        - "loop..."
    tags:
      - test_app
    platform_allow:
      - native_sim (editado)
```

## prj.conf
```kconfig
# Copyright (c) 2021 Nordic Semiconductor ASA
# SPDX-License-Identifier: Apache-2.0
#
# This is a Kconfig fragment which can be used to enable debug-related options
# in the application. See the README for more details.

# compiler
CONFIG_DEBUG_OPTIMIZATIONS=y

# logging
CONFIG_LOG=y
CONFIG_APP_LOG_LEVEL_DBG=y

CONFIG_SENSOR=n
```

## src/main.c
```c
/*
 * Copyright (c) 2021 Nordic Semiconductor ASA
 * SPDX-License-Identifier: Apache-2.0
 */

#include <zephyr/drivers/sensor.h>
#include <zephyr/kernel.h>
#include <zephyr/logging/log.h>

#include <app_version.h>

LOG_MODULE_REGISTER(main, CONFIG_APP_LOG_LEVEL);

int main(void)
{

	LOG_INF("Zephyr Example Application %s\n", APP_VERSION_STRING);

	while(1){
		k_sleep(K_MSEC(2000));
		LOG_INF("loop...");
	}

	return 0;
}
```
